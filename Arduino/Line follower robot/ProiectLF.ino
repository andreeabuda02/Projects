#include <Adafruit_GFX.h>
#include <Adafruit_SSD1306.h>

// Pinii motor 1
#define mpin00 5
#define mpin01 6
// Pinii motor 2
#define mpin10 3
#define mpin11 11

#define trigPin 9
#define echoPin 10

// definire variabile
long durata;
int distanta;


#define Lpin A0  // define L signal pin
#define Cpin A1  // define C signal pin
#define Rpin A2  // define R signal pin
int L;           // define variable to store value read from pin
int C;           // define variable to store value read from pin
int R;           // define variable to store value read from pin

static const unsigned char PROGMEM directii[][1024]={
  //inainte
  {0x00, 0x00, 0x00, 0x00, 0x00, 0x00, 0x00, 0x00, 0x00, 0x00, 0x00, 0x00, 0x00, 0x00, 0x00, 0x00, 
    0x00, 0x00, 0x00, 0x00, 0x00, 0x00, 0x00, 0x00, 0x00, 0x00, 0x00, 0x00, 0x00, 0x00, 0x00, 0x00, 
    0x00, 0x00, 0x00, 0x00, 0x00, 0x00, 0x00, 0x00, 0x00, 0x00, 0x00, 0x00, 0x00, 0x00, 0x00, 0x00, 
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    0x00, 0x00, 0x00, 0x00, 0x00, 0x00, 0x00, 0x00, 0x00, 0x00, 0x00, 0x00, 0x00, 0x00, 0x00, 0x00},
  //stop
  {0x00, 0x00, 0x00, 0x00, 0x00, 0x00, 0x00, 0x00, 0x00, 0x00, 0x00, 0x00, 0x00, 0x00, 0x00, 0x00, 
    0x00, 0x00, 0x00, 0x00, 0x00, 0x00, 0x00, 0x00, 0x00, 0x00, 0x00, 0x00, 0x00, 0x00, 0x00, 0x00, 
    0x00, 0x00, 0x00, 0x00, 0x00, 0x00, 0x00, 0x00, 0x00, 0x00, 0x00, 0x00, 0x00, 0x00, 0x00, 0x00, 
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    0x00, 0x00, 0x00, 0x00, 0x00, 0x00, 0x00, 0x00, 0x00, 0x00, 0x00, 0x00, 0x00, 0x00, 0x00, 0x00},
  //stanga
  {0x00, 0x00, 0x00, 0x00, 0x00, 0x00, 0x00, 0x00, 0x00, 0x00, 0x00, 0x00, 0x00, 0x00, 0x00, 0x00, 
    0x00, 0x00, 0x00, 0x00, 0x00, 0x00, 0x00, 0x00, 0x00, 0x00, 0x00, 0x00, 0x00, 0x00, 0x00, 0x00, 
    0x00, 0x00, 0x00, 0x00, 0x00, 0x00, 0x00, 0x00, 0x00, 0x00, 0x00, 0x00, 0x00, 0x00, 0x00, 0x00, 
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    0x00, 0x00, 0x00, 0x00, 0x00, 0x00, 0x00, 0x00, 0x00, 0x00, 0x00, 0x00, 0x00, 0x00, 0x00, 0x00},
  //dreapta
  {0x00, 0x00, 0x00, 0x00, 0x00, 0x00, 0x00, 0x00, 0x00, 0x00, 0x00, 0x00, 0x00, 0x00, 0x00, 0x00, 
    0x00, 0x00, 0x00, 0x00, 0x00, 0x00, 0x00, 0x00, 0x00, 0x00, 0x00, 0x00, 0x00, 0x00, 0x00, 0x00, 
    0x00, 0x00, 0x00, 0x00, 0x00, 0x00, 0x00, 0x00, 0x00, 0x00, 0x00, 0x00, 0x00, 0x00, 0x00, 0x00, 
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    0x00, 0x00, 0x00, 0x00, 0x00, 0x00, 0x00, 0x00, 0x00, 0x00, 0x00, 0x00, 0x00, 0x00, 0x00, 0x00}
};


#define OLED_WIGTH 128
#define OLED_HEIGHT 64
#define OLED_RESET -1
#define SCREEN_ADDRESS 0x3C 

Adafruit_SSD1306 display(OLED_WIGTH,OLED_HEIGHT,&Wire,OLED_RESET);



void setup() {
  // configurarea pinilor motor ca iesire, initial valoare 0
  digitalWrite(mpin00, 0);
  digitalWrite(mpin01, 0);
  digitalWrite(mpin10, 0);
  digitalWrite(mpin11, 0);
  pinMode(mpin00, OUTPUT);
  pinMode(mpin01, OUTPUT);
  pinMode(mpin10, OUTPUT);
  pinMode(mpin11, OUTPUT);
  // pin LED
  pinMode(13, OUTPUT);

  pinMode(trigPin, OUTPUT);  // seteaza trigPin ca Output
  pinMode(echoPin, INPUT);   // seteaza echoPin ca Input

  pinMode(Lpin, INPUT);  // set the L signal pin as an input
  pinMode(Cpin, INPUT);  // set the C signal pin as an input
  pinMode(Rpin, INPUT);  // set the R signal pin as an input

  //initializare OLED
  if(!display.begin(SSD1306_SWITCHCAPVCC, SCREEN_ADDRESS)) {
    Serial.println(F("SSD1306 allocation failed"));
    for(;;); // Don't proceed, loop forever
  }

  Serial.begin(9600);
}
// Funcție pentru controlul unui motor
// Intrare: pinii m1 și m2, direcția și viteza
void StartMotor(int m1, int m2, int forward, int speed) {

  if (speed == 0)  // oprire
  {
    digitalWrite(m1, 0);
    digitalWrite(m2, 0);
  } else {
    if (forward) {
      digitalWrite(m2, 0);

      analogWrite(m1, speed);  // folosire PWM
    } else {
      digitalWrite(m1, 0);
      analogWrite(m2, speed);
    }
  }
}
// Funcție de siguranță
// Execută oprire motoare, urmată de delay
void delayStopped(int ms) {
  StartMotor(mpin00, mpin01, 0, 0);
  StartMotor(mpin10, mpin11, 0, 0);
  delay(ms);
}



////////////////////////////////////////////////////////////////////////////////pentru toate, inclusiv senzorul urmaritor de linie, care nu merge chiar bine



// bool leftIsBlack() {
//   return L < 900;
// }

// bool rightIsBlack() {
//   return R < 900;
// }

// bool centreIsBlack() {
//   return C < 900;
// }


//  void loop() {

//    // Clears the trigPin
//    digitalWrite(trigPin, LOW);
//    delayMicroseconds(2);
//    // Sets the trigPin on HIGH state for 10 micro seconds
//    digitalWrite(trigPin, HIGH);
//    delayMicroseconds(10);
//    digitalWrite(trigPin, LOW);
//    // Reads the echoPin, returns the sound wave travel time in microseconds
//    durata = pulseIn(echoPin, HIGH);
//    // Calculating the distance
//    distanta = durata * 0.034 / 2;

//    display.clearDisplay();


//    if (distanta <= 10) {
//      StartMotor(mpin00, mpin01, 1, 0);
//      StartMotor(mpin10, mpin11, 0, 0);
//      display.drawBitmap(0, 0, directii[1],OLED_WIGTH,OLED_HEIGHT,WHITE);
//    } else {

//      L = analogRead(Lpin);  // read the voltage level
//      C = analogRead(Cpin);  // read the voltage level
//      R = analogRead(Rpin);  // read the voltage level
//      //Serial.println(L);
//      //Serial.println(C);
//      //Serial.println(R);  // send the result to the serial monitor
//      //Serial.println("");
//      //delay(1000);         // pause for a moment before repeating

//      if (centreIsBlack() == true && leftIsBlack() == false && rightIsBlack() == false) {
//        // Acum se pornesc motoarele DC
//        StartMotor(mpin00, mpin01, 0, 200);
//        StartMotor(mpin10, mpin11, 1, 200);
//        display.drawBitmap(0, 0, directii[0], OLED_WIGTH, OLED_HEIGHT,WHITE);

//      } else if (leftIsBlack() == true && centreIsBlack() == false && rightIsBlack() == false) {
//        //move left, turn on right motor;
//        // Acum se pornesc motoarele DC
//        StartMotor(mpin00, mpin01, 0, 200);
//        StartMotor(mpin10, mpin11, 1, 100);
//        display.drawBitmap(0, 0, directii[2], OLED_WIGTH, OLED_HEIGHT,WHITE);

//      } else if (rightIsBlack() == true && centreIsBlack() == false && leftIsBlack() == false) {
//        //move right, turn on left motor;
//        // Acum se pornesc motoarele DC
//        StartMotor(mpin00, mpin01, 0, 100);
//        StartMotor(mpin10, mpin11, 1, 200);
//        display.drawBitmap(0, 0, directii[3], OLED_WIGTH, OLED_HEIGHT,WHITE);

//      } else if (rightIsBlack() == true && centreIsBlack() == true && leftIsBlack() == true) {
//        // Acum se pornesc motoarele DC
//        StartMotor(mpin00, mpin01, 0, 100);
//        StartMotor(mpin10, mpin11, 1, 100);
//        display.drawBitmap(0, 0, directii[0], OLED_WIGTH, OLED_HEIGHT,WHITE);
//      }

//      delay(200);  // Cât timp e motorul pornit
//    }

//    display.display();
//    //delay (1000); // Cât timp e motorul pornit
//  }




/////////////////////////////////////////////////////////////////////////////////////numai pentru senzorul ultrasonic

void loop() {

  // Clears the trigPin
  digitalWrite(trigPin, LOW);
  delayMicroseconds(2);
  // Sets the trigPin on HIGH state for 10 micro seconds
  digitalWrite(trigPin, HIGH);
  delayMicroseconds(10);
  digitalWrite(trigPin, LOW);
  // Reads the echoPin, returns the sound wave travel time in microseconds
  durata = pulseIn(echoPin, HIGH);
  // Calculating the distance
  distanta = durata * 0.034 / 2;

  display.clearDisplay();

  if (distanta <= 15) {
    StartMotor(mpin00, mpin01, 1, 0);
    StartMotor(mpin10, mpin11, 0, 0);
    display.drawBitmap(0,0,directii[1],OLED_WIGTH,OLED_HEIGHT,WHITE);
  } else {
    StartMotor(mpin00, mpin01, 0, 200);
    StartMotor(mpin10, mpin11, 1, 200);
    display.drawBitmap(0,0,directii[0],OLED_WIGTH,OLED_HEIGHT,WHITE);
    delay(200);  // Cât timp e motorul pornit
  }

  display.display();

  //delay (1000); // Cât timp e motorul pornit
}